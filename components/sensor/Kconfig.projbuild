## components/sensor/Kconfig.projbuild
```kconfig
menu "Sensors Configuration"

config SENSOR_RESET_IO
    int "sensor reset GPIO"
    default 4
    help
	select a gpio as the reset pin. Reset this pin to reset all devices.

config SENSOR_IRQ_IO
    int "sensor interrupt gpio"
    default 5
    help
	input gpio. If an interrupt is generated by devices, this pin will be set.


config I2C_MASTER_SCL_I0
    int "i2c master SCL IO"
    default 16
    help
    	gpio number for I2C master clock

config I2C_MASTER_SDA_I0
    int "i2c master SDA IO"
    default 13
    help
    	gpio number for I2C master data

config I2C_MASTER_FREQ_HZ
    int "i2c master frequency(Hz)"
    default 100000
    help
    	I2C master clock frequency


config READ_SENSOR_DATA_LENGTH
    int "Read data length from sensor"
    default 65
    help
    	How many bytes are read from sensor each time

config READ_FREQUENCY
    int "Read data frequency from sensor"
    default 10
    help
    	How often bytes are read from sensor each time

config MAX_SENSOR_ADDR
    int "Maximum address of sensors"
    default 10
    help
    	Maximum address of sensors that will be searched

config MAX_SENSOR_NUM
    int "Maximum number of sensors"
    default 5
    help
    	Maximum number of sensors supported

endmenu
```

## main/Kconfig.projbuild
```kconfig
menu " TCP or UDP"

choice SERVER_CLIENT_ENABLE
    prompt "Work with SERVER or CLIENT" 
    default CLIENT_ENABLE
config CLIENT_ENABLE
        bool "CLIENT is enable"
        help
            Select this to set the board work with client
config SERVER_ENABLE
        bool "SERVER is enable"
        help
            Select this to set the board work with server, hier it isn't used.
endchoice
            
choice TCP_UDP_CLIENT_ENABLE
    prompt "Work with TCP or UDP" 
    default TCP_CLIENT_ENABLE
    depends on CLIENT_ENABLE
config TCP_CLIENT_ENABLE
    bool "Tcp_client is enable"
    help
        Select this to set the board work with Tcp_client
config UDP_CLIENT_ENABLE
    bool "Udp_client is enable"
    help
        Select this to set the board work with Udp_client

endchoice  
        
config EXAMPLE_PORT
    int "Port"
    range 0 65535
    default 3333
    help
        Local port the example server will listen on.

choice EXAMPLE_IP_MODE
    prompt "IP Version"
    depends on EXAMPLE_SOCKET_IP_INPUT_STRING
    help
        Example can use either IPV4 or IPV6.
        
    config EXAMPLE_IPV4
    bool "IPV4"
        
    config EXAMPLE_IPV6
    bool "IPV6"
        
endchoice
        
config EXAMPLE_IPV4_ADDR
    string "IPV4 Address"
    default "192.168.0.100"
    depends on EXAMPLE_IPV4
    help
    The example will connect to this IPV4 address.
        
config EXAMPLE_IPV6_ADDR
    string "IPV6 Address"
    default "FE80::30AD:E57B:C212:68AD"
    depends on EXAMPLE_IPV6
    help
        he example will connect to this IPV6 address.
        

        
choice EXAMPLE_SOCKET_IP_INPUT
            prompt "Socket example source"
            default EXAMPLE_SOCKET_IP_INPUT_STRING
            depends on CLIENT_ENABLE
            help
                Selects the input source of the IP used in the example.
        
            config EXAMPLE_SOCKET_IP_INPUT_STRING
                bool "From string"
        
            config EXAMPLE_SOCKET_IP_INPUT_STDIN
                bool "From stdin"
endchoice





endmenu
```
